## meta-ibm/meta-genesis3/conf/machine/genesis3.conf
```bitbake
KMACHINE = "aspeed"
KERNEL_DEVICETREE = "${KMACHINE}-bmc-ibm-${MACHINE}.dtb"

UBOOT_MACHINE = "evb-ast2500_defconfig"
UBOOT_MAKE_TARGET += " DEVICE_TREE=ibm-genesis3"
FLASH_SIZE = "32768"

OBMC_POWER_SUPPLY_INSTANCES = "0 1 2 3"

MACHINE_FEATURES += "\
        obmc-bmc-state-mgmt \
        obmc-phosphor-fan-mgmt \
        obmc-phosphor-chassis-mgmt \
        obmc-chassis-state-mgmt \
	obmc-host-state-mgmt \
        "

require conf/machine/include/ast2500.inc
require conf/machine/include/obmc-bsp-common.inc

PREFERRED_PROVIDER_virtual/phosphor-led-manager-config-native = "gen3-led-manager-config-native"

VIRTUAL-RUNTIME_obmc-host-state-manager = "pwrseqd"
VIRTUAL-RUNTIME_obmc-chassis-state-manager = "pwrseqd"

PREFERRED_PROVIDER_virtual/obmc-flash-mgmt = "packagegroup-genesis3-apps"
PREFERRED_PROVIDER_virtual/obmc-system-mgmt = "packagegroup-genesis3-apps"
PREFERRED_PROVIDER_virtual/obmc-fan-mgmt = "packagegroup-genesis3-apps"
PREFERRED_PROVIDER_virtual/obmc-chassis-mgmt = "packagegroup-genesis3-apps"
```

## meta-ibm/meta-sbp1/conf/machine/sbp1.conf
```bitbake
KERNEL_DEVICETREE = "sbp1.dtb"

#UBOOT_MACHINE = "ast2600_openbmc_defconfig"
UBOOT_MACHINE = "ast2600_openbmc_spl_defconfig"
UBOOT_DEVICETREE = "ast2600-sbp1"
SOCSEC_SIGN_ENABLE = "0"
SPL_BINARY = "spl/u-boot-spl.bin"
FLASH_SIZE = "65536"

SERIAL_CONSOLES = "115200;ttyS0"

OBMC_POWER_SUPPLY_INSTANCES = "0 1 2 3"

MACHINE_FEATURES += "\
        obmc-bmc-state-mgmt \
        obmc-phosphor-fan-mgmt \
        obmc-phosphor-chassis-mgmt \
        obmc-chassis-state-mgmt \
	obmc-host-state-mgmt \
        "

require conf/machine/include/ast2600.inc
require conf/machine/include/obmc-bsp-common.inc

PREFERRED_PROVIDER_virtual/phosphor-led-manager-config-native = "gen3-led-manager-config-native"

VIRTUAL-RUNTIME_obmc-host-state-manager = "pwrseqd"
VIRTUAL-RUNTIME_obmc-chassis-state-manager = "pwrseqd"

PREFERRED_PROVIDER_virtual/obmc-flash-mgmt = "packagegroup-sbp1-apps"
PREFERRED_PROVIDER_virtual/obmc-system-mgmt = "packagegroup-sbp1-apps"
PREFERRED_PROVIDER_virtual/obmc-fan-mgmt = "packagegroup-sbp1-apps"
PREFERRED_PROVIDER_virtual/obmc-chassis-mgmt = "packagegroup-sbp1-apps"
```

## meta-ibmcloud/conf/layer.conf
```bitbake
# We have a conf and classes directory, add to BBPATH
BBPATH .= ":${LAYERDIR}"

# We have recipes-* directories, add to BBFILES
BBFILES += "${LAYERDIR}/meta-common/recipes-*/*/*.bb \
            ${LAYERDIR}/meta-common/recipes-*/*/*.bbappend"

BBFILE_COLLECTIONS += "ibmcloud-layer"
BBFILE_PATTERN_ibmcloud-layer = "^${LAYERDIR}/"
LAYERVERSION_ibmcloud-layer = "1"
LAYERSERIES_COMPAT_ibmcloud-layer = "gatesgarth hardknott"
```

## meta-ibmcloud/meta-covi/conf/layer.conf
```bitbake
# We have a conf and classes directory, add to BBPATH
BBPATH .= ":${LAYERDIR}"

# We have recipes-* directories, add to BBFILES
BBFILES += "${LAYERDIR}/recipes-*/*/*.bb \
            ${LAYERDIR}/recipes-*/*/*.bbappend"

BBFILE_COLLECTIONS += "covi-layer"
BBFILE_PATTERN_covi-layer = "^${LAYERDIR}/"
LAYERSERIES_COMPAT_covi-layer = "gatesgarth hardknott"
```

## meta-ibmcloud/meta-gen3/conf/machine/gen3.conf
```bitbake
KMACHINE = "aspeed"
KERNEL_DEVICETREE = "${KMACHINE}-bmc-ibm-${MACHINE}.dtb"

UBOOT_MACHINE = "ast_g5_phy_config"

FLASH_SIZE = "32768"

require conf/machine/include/ast2500.inc
require conf/machine/include/obmc-bsp-common.inc

PREFERRED_PROVIDER_virtual/phosphor-led-manager-config-native = "gen3-led-manager-config-native"

PREFERRED_PROVIDER_virtual/obmc-flash-mgmt = "packagegroup-ibmcloud-apps"
PREFERRED_PROVIDER_virtual/obmc-system-mgmt = "packagegroup-ibmcloud-apps"
```

## meta-ocp/meta-tiogapass/conf/machine/ocp-tiogapass.conf
```bitbake
KMACHINE = "aspeed"
KERNEL_DEVICETREE = "aspeed/${KMACHINE}-bmc-${MACHINE}.dtb"

PREFERRED_PROVIDER_virtual/bootloader = "u-boot-aspeed-sdk"
PREFERRED_PROVIDER_u-boot = "u-boot-aspeed-sdk"
PREFERRED_PROVIDER_u-boot-fw-utils = "u-boot-fw-utils-aspeed-sdk"

UBOOT_DEVICETREE = "ast2500-evb"
UBOOT_MACHINE = "evb-ast2500_defconfig"

FLASH_SIZE = "65536"

SERIAL_CONSOLES = "57600;ttyS4"

require conf/machine/include/ast2500.inc
require conf/machine/include/obmc-bsp-common.inc
require conf/machine/include/ocp.inc
```
